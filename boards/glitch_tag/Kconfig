## boards/glitch_tag/Kconfig.glitch_tag
```kconfig
# glitch tag board configuration

# Copyright (c) 2025
# SPDX-License-Identifier: Apache-2.0

config BOARD_GLITCH_TAG
	select SOC_NRF52832_QFAA
```

## boards/glitch_tag/board.yml
```yaml
board:
  name: glitch_tag
  full_name: nRF52 Glitch Tag
  vendor: stacksmashing
  socs:
  - name: nrf52832
```

## boards/glitch_tag/glitch_tag_defconfig
```kconfig
# SPDX-License-Identifier: Apache-2.0

# Enable MPU
CONFIG_ARM_MPU=y

# Enable hardware stack protection
CONFIG_HW_STACK_PROTECTION=y

# Enable GPIO
CONFIG_GPIO=y

# Enable uart driver
CONFIG_SERIAL=y

# Enable console
CONFIG_CONSOLE=y
CONFIG_UART_CONSOLE=y

# The glitch tag has no external LF oscillator, and we need those pins for uart output,
# so we have to override the default external LF clock source and disable the default
# two-stage LF clock startup sequence.
CONFIG_CLOCK_CONTROL_NRF_K32SRC_RC=y
```
